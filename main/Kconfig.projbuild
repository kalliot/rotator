## main/Kconfig.projbuild
```kconfig
menu "Rotator configuration"

    config CCWBUTTON_GPIO
        int "Gpio for turn counterclockwise button"
        range 0 36
        default 12
        help
            This handles the ccw button.

    config CWBUTTON_GPIO
        int "Gpio for turn clockwise button"
        range 0 36
        default 13
        help
            This handles the cw button.


    config CCWRELAY_GPIO
        int "Gpio for turn counterclockwise relay"
        range 0 36
        default 17
        help
            This handles the ccw relay.

    config CWRELAY_GPIO
        int "Gpio for turn clockwise relay"
        range 0 36
        default 16
        help
            This handles the cw relay.

    config ESP_WIFI_SSID
        string "WiFi SSID"
        default "myssid"
        help
            SSID (network name) created when in setup mode.

    config ESP_WIFI_PASSWORD
        string "WiFi Password"
        default "mypassword"
        help
            WiFi password (WPA or WPA2) for the example to use.

    config ESP_WIFI_CHANNEL
        int "WiFi Channel"
        range 1 13
        default 1
        help
            WiFi channel (network channel) for the example to use.

    config ESP_MAX_STA_CONN
        int "Maximal STA connections"
        default 1
        help
            Max number of the STA connects to AP.

    config OTA_RECV_TIMEOUT
        int "OTA Receive Timeout"
        default 5000
        help
            Maximum time for reception

    config FIRMWARE_UPGRADE_URL
        string "Firmware Upgrade url basepath"
        default "https://192.168.101.233:8070/ota"
        help
            Base URL of server which hosts the firmware images.


    config ENABLE_PARTIAL_HTTP_DOWNLOAD
        bool "Enable partial HTTP download"
        default n
        help
            This enables use of Range header in esp_https_ota component.
            Firmware image will be downloaded over multiple HTTP requests.

    config HTTP_REQUEST_SIZE
        int "HTTP request size"
        default MBEDTLS_SSL_IN_CONTENT_LEN
        depends on ENABLE_PARTIAL_HTTP_DOWNLOAD
        help
            This options specifies HTTP request size. Number of bytes specified
            in this option will be downloaded in single HTTP request.

endmenu
```
